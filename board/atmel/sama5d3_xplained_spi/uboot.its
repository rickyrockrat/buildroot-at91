## board/atmel/sama5d3_xplained_spi/uboot.its
```
/dts-v1/;

/ {
    description = "Buildroot kernel for sama5d3_explained on SPI";
    images {
        kernel@1 {
            description = "kernel";
            data = /incbin/("./zImage");
            type = "kernel";
            arch = "arm";
            os = "linux";
            compression = "none";
            load = <0x22000000>;
            entry = <0>;
            hash@1 {
                algo = "sha1";
            };
        };
        fdt@1 {
            description = "FDT blob";
            data = /incbin/("./at91-sama5d3_xplained.dtb");
            type = "flat_dt";
            arch = "arm";
            compression = "none";
            load=<0x21000000>;
            hash@1 {
                algo = "sha1";
            };
        };
        ramdisk@1 {
            description = "ramdisk";
            data = /incbin/("./rootfs.cpio.uboot");
            type = "ramdisk";
            arch = "arm";
            os = "linux";
            compression = "gzip";
            load = <0x21010000>;
            entry = <00000000>;
            hash@1 {
                algo = "sha1";
            };
        };
    };
    configurations {
        default = "conf@1";
        conf@1{
            kernel = "kernel@1";
            ramdisk = "ramdisk@1";
            fdt = "fdt@1";
        };
    };
};
```

## configs/atmel_sama5d3_xplained_spiflash_defconfig
```kconfig
BR2_arm=y
BR2_cortex_a5=y
BR2_ARM_ENABLE_VFP=y
BR2_ARM_INSTRUCTIONS_THUMB2=y
BR2_PACKAGE_HOST_LINUX_HEADERS_CUSTOM_5_4=y
BR2_LINUX_KERNEL=y
BR2_LINUX_KERNEL_CUSTOM_TARBALL=y
BR2_LINUX_KERNEL_CUSTOM_TARBALL_LOCATION="$(call github,rickyrockrat,linux-at91,spi_boot)/linux-linux4sam_6.2.tar.gz"
BR2_LINUX_KERNEL_DEFCONFIG="sama5d3"atmel_sama5d3_xplained_spiflash_defconfig
BR2_LINUX_KERNEL_DTS_SUPPORT=y
BR2_LINUX_KERNEL_INTREE_DTS_NAME="at91-sama5d3_xplained"
BR2_LINUX_KERNEL_NEEDS_HOST_OPENSSL=y
BR2_LINUX_KERNEL_ZIMAGE=y
BR2_TARGET_ROOTFS_SQUASHFS=y
BR2_TARGET_ROOTFS_SQUASHFS4_GZIP=y
BR2_TARGET_AT91BOOTSTRAP3=y
BR2_TARGET_AT91BOOTSTRAP3_CUSTOM_TARBALL=y
BR2_TARGET_AT91BOOTSTRAP3_CUSTOM_TARBALL_LOCATION="$(call github,rickyrockrat,at91bootstrap,spi_boot)/at91bootstrap3-v3.9.2.tar.gz"
BR2_TARGET_AT91BOOTSTRAP3_DEFCONFIG="sama5d3_xplainednf_uboot"
BR2_TARGET_UBOOT=y
BR2_TARGET_UBOOT_BUILD_SYSTEM_KCONFIG=y
BR2_TARGET_UBOOT_CUSTOM_TARBALL=y
BR2_TARGET_UBOOT_CUSTOM_TARBALL_LOCATION="$(call github,rickyrockrat,u-boot-at91,spi_boot)/u-boot-at91-linux4sam_6.2.tar.gz"
BR2_TARGET_UBOOT_BOARD_DEFCONFIG="sama5d3_xplained_serialflash"
BR2_TARGET_UBOOT_NEEDS_DTC=y
BR2_PACKAGE_HOST_SAM_BA=y
BR2_TARGET_ROOTFS_CPIO=y
BR2_TARGET_ROOTFS_CPIO_GZIP=y
BR2_ROOTFS_POST_IMAGE_SCRIPT="board/atmel/sama5d3_xplained_spi/post-image.sh"
BR2_ROOTFS_POST_SCRIPT_ARGS="board/atmel/sama5d3_xplained_spi/uboot.its"
BR2_PACKAGE_HOST_UBOOT_TOOLS=y
BR2_PACKAGE_HOST_UBOOT_TOOLS_FIT_SUPPORT=y
BR2_PACKAGE_HOST_UBOOT_TOOLS_FIT_SIGNATURE_SUPPORT=y
BR2_PACKAGE_HOST_GENIMAGE=y
```

## package/client-hal-api/Config.in
```kconfig
config BR2_PACKAGE_CLIENT_HAL_API
	bool "client_hal_api"
	help
	  An Hardware Abstraction Layer for a client talking to a generic register/buffer address space.
	  
config BR2_PACKAGE_CLIENT_HAL_API_URL
	string "URL of client_hal_api source"
	depends on BR2_PACKAGE_CLIENT_HAL_API
	help
	  Set the path to the git repo for this project.

config BR2_PACKAGE_CLIENT_HAL_API_VERSION
	string "Version for client_hal_api source"
	depends on BR2_PACKAGE_CLIENT_HAL_API
	default "master"
	help
	  Set the version for this package.
	  
```

## package/elinux-hal-api/Config.in
```kconfig
config BR2_PACKAGE_ELINUX_HAL_API
	bool "elinux_hal_api"
	help
	  A Hardware Abstracted Layer implementation for Linux
	  
config BR2_PACKAGE_ELINUX_HAL_API_URL
	string "URL of elinux_hal_api source"
	depends on BR2_PACKAGE_ELINUX_HAL_API
	help
	  Set the path to the git repo for this project.

config BR2_PACKAGE_ELINUX_HAL_API_VERSION
	string "Version for elinux_hal_api source"
	depends on BR2_PACKAGE_ELINUX_HAL_API
	default "master"
	help
	  Set the version for this package.
	  
```

## package/hal-sim/Config.in
```kconfig
config BR2_PACKAGE_HAL_SIM
	bool "hal_sim"
	select BR2_PACKAGE_SIG_LIBCOMM
	select BR2_PACKAGE_CLIENT_HAL_API
	help
	  A client-server simulation for several HAL layers.
	  
config BR2_PACKAGE_HAL_SIM_URL
	string "URL of hal_sim source"
	depends on BR2_PACKAGE_HAL_SIM
	help
	  Set the path to the git repo for this project.

config BR2_PACKAGE_HAL_SIM_VERSION
	string "Version for hal_sim source"
	depends on BR2_PACKAGE_HAL_SIM
	default "master"
	help
	  Set the version for this package.
	  
```

## package/sig-libcomm/Config.in
```kconfig
config BR2_PACKAGE_SIG_LIBCOMM
	bool "sig-libcomm"
	help
	  Multi-transport, cross platform communications library
	  
config BR2_PACKAGE_SIG_LIBCOMM_URL
	string "URL of sig-libcomm source"
	depends on BR2_PACKAGE_SIG_LIBCOMM
	help
	  Set the path to the git repo for this project.

config BR2_PACKAGE_SIG_LIBCOMM_VERSION
	string "Version for sig-libcomm source"
	depends on BR2_PACKAGE_SIG_LIBCOMM
	default "master"
	help
	  Set the version for this package.

config BR2_PACKAGE_SIG_LIBCOMM_ARCH
	string
	default "arm"        if BR2_arm || BR2_armeb
	default "linux32"     if BR2_i386 && BR2_ARCH="i686"
	default "linux64"     if BR2_x86_64	  
```
